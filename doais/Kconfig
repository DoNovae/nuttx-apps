## doais/Kconfig
```kconfig
#
# For a description of the syntax of this configuration file,
# see the file kconfig-language.txt in the NuttX tools repository.
#

config DOAIS
	tristate "DoAIs"
	default n
	---help---
		Enable the DoAIs
```

## examples/lvgldemo1/Kconfig
```kconfig
#
# For a description of the syntax of this configuration file,
# see the file kconfig-language.txt in the NuttX tools repository.
#

menuconfig EXAMPLES_LVGLDEMO1
	tristate "LVGL Demo1"
	default n
	depends on GRAPHICS_LVGL
	---help---
		Enable build the Light and Versatile Graphics Library Demo programs

if EXAMPLES_LVGLDEMO1

config EXAMPLES_LVGLDEMO1_PRIORITY
	int "lvgldemo task priority"
	default 100

config EXAMPLES_LVGLDEMO1_STACKSIZE
	int "lvgldemo stack size"
	default 16384

endif # EXAMPLES_LVGLDEMO1
```
